## apps/slideshow/esp32/main/Kconfig.projbuild
```kconfig
# SPDX-License-Identifier: Apache-2.0

menu "Slideshow test app"

    config HAC_SLIDESHOW_INTERVAL_S
        int "Seconds from the end of one picture's refresh to the next"
        range 1 86400
        default 60
        help
            Every picture is a whole-panel REFRESH_FULL, about 3.3 s on this
            panel. A value below the panel's minimum full-refresh interval
            (BOARD_EPD_MIN_FULL_REFRESH_INTERVAL_MS in
            platform/esp32_t5s3/board_config.h, 60 s) is raised to it at
            runtime -- unless HAC_SLIDESHOW_OVERRIDE_PANEL_MINIMUM says
            otherwise: the slideshow drives the glass no harder than the
            product may.

    config HAC_SLIDESHOW_OVERRIDE_PANEL_MINIMUM
        bool "Let the interval go below the panel's minimum full-refresh interval"
        default n
        help
            For comparison runs only -- several variants of a picture side
            by side in time, where a minute between them makes the
            comparison hard. With this set, HAC_SLIDESHOW_INTERVAL_S is used
            as given instead of being raised to
            BOARD_EPD_MIN_FULL_REFRESH_INTERVAL_MS (60 s), and the boot log
            says so at WARN.

            That 60 s is a guard on the flashing full refresh, not a
            measured limit: the vendor gives no figure, and nothing has been
            observed to argue for another (docs/adr/0008-panel-timing.md).
            Running under it drives the panel harder than the product ever
            will, so leave this n for anything meant to run for long.

    config HAC_SLIDESHOW_CAPTION
        bool "Caption each picture with its number and file name"
        default y
        help
            A small boxed "n/N name" in the bottom-left corner, so a photo
            of the panel says which picture -- and which dithering -- it
            shows. Turn it off for pictures meant to be looked at.

endmenu
```
