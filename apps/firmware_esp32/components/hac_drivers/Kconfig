## apps/firmware_esp32/components/hac_drivers/Kconfig
```kconfig
# SPDX-License-Identifier: Apache-2.0
#
# In the drivers' component rather than main/Kconfig.projbuild, so that the
# firmware and the on-target test app (apps/firmware_esp32/test_app/), which
# link this component but not main/, see the same symbol.

menu "Home Air Monitor: sensor drivers"

    config HAC_BSEC
        bool "Compute IAQ with Bosch's BSEC2 (needs its library in third_party/bsec/)"
        default n
        help
            Phase 3d (docs/adr/0020-bsec-iaq.md). Measures the BME68x through
            drivers/bme68x/bme68x_bsec_source.c: Bosch's BSEC2 library decides
            when the sensor measures and with which heater profile, compensates
            temperature and humidity for the sensor's own heating, and computes
            an index of air quality, which the home screen shows in its IAQ
            cell. BSEC's CO2 equivalent is never computed.

            Needs Bosch's BSEC2 2.6.1.0 archive, downloaded after accepting
            Bosch's licence agreement and unpacked as it comes into
            third_party/bsec/, which is gitignored (THIRD_PARTY_NOTICES.md).
            It is never committed, so this is off by default: CI and a fresh
            clone build without it, and the BME68x is then measured by
            drivers/bme68x/bme68x_source.c and the IAQ cell shows raw gas
            resistance (docs/requirements.md 17.2).

            Build it in a directory and sdkconfig of its own, from
            sdkconfig.bsec, so the setting never depends on an sdkconfig made
            before the symbol existed:

              idf.py -B build-bsec -D SDKCONFIG=build-bsec/sdkconfig \
                  -D "SDKCONFIG_DEFAULTS=sdkconfig.defaults;sdkconfig.bsec" build

            An image built with this carries Bosch's proprietary library: do
            not attach it to a release (THIRD_PARTY_NOTICES.md).

endmenu
```

## apps/firmware_esp32/components/hac_platform/Kconfig
```kconfig
# SPDX-License-Identifier: Apache-2.0
#
# In the platform's component rather than main/Kconfig.projbuild, so that the
# firmware and the on-target test app (apps/firmware_esp32/test_app/), which
# link this component but not main/, see the same symbols -- as
# components/hac_drivers/Kconfig does for HAC_BSEC.

menu "Home Air Monitor: Wi-Fi"

    config HAC_WIFI_SSID
        string "Wi-Fi network name (SSID)"
        default ""
        help
            Phase 4e (docs/adr/0032-wifi-on-the-board.md). The network the
            board's station joins (platform/esp32_t5s3/adp_net.c), 1 to 32
            octets. Empty -- the default -- means no network: the firmware
            never starts Wi-Fi and runs as before, and the test app reports
            the port_net contract as IGNORED.

            Never set it here or in sdkconfig.defaults. It belongs in the
            gitignored overlay apps/firmware_esp32/sdkconfig.credentials
            (copied from sdkconfig.credentials.example), which every build of
            the firmware and the test app layers last over its defaults, and
            which survives a deleted sdkconfig. An overlay reaches only a
            fresh sdkconfig: after changing it, delete the build's sdkconfig
            and run idf.py reconfigure -- the build refuses to go on while
            the two disagree (cmake/credentials_idf.cmake).

            An image built with it holds it in plain text: never attach one
            to an issue or a pull request.

    config HAC_WIFI_PASSWORD
        string "Wi-Fi password"
        default ""
        help
            The network's WPA2/WPA3 password, 8 to 64 characters, or empty
            for an open network. Set beside HAC_WIFI_SSID in
            sdkconfig.credentials, never anywhere committed. Handed to
            ESP-IDF's driver in RAM only and never logged; the boot log gives
            its length.

endmenu

menu "Home Air Monitor: MQTT"

    config HAC_MQTT_BROKER_URI
        string "MQTT broker (mqtt://<host>[:<port>])"
        default ""
        help
            Phase 4g (docs/adr/0033-mqtt-on-the-board.md). The broker the
            board reports to (platform/esp32_t5s3/adp_mqtt.c), plain MQTT on
            the local network: mqtt://192.168.1.10:1883, or a name the
            router's DNS resolves (lwIP does not do mDNS: not .local). No
            TLS -- mqtts:// is refused -- and no user or password in the URI:
            they have symbols of their own. Empty -- the default -- means no
            MQTT: the firmware runs as before, Wi-Fi and SNTP included, and
            the test app reports the port_telemetry contract as IGNORED.
            Needs HAC_WIFI_SSID.

            Set it in the gitignored overlay
            apps/firmware_esp32/sdkconfig.credentials, beside the Wi-Fi
            network, never here or in sdkconfig.defaults: it says where the
            owner's network has its broker. An overlay reaches only a fresh
            sdkconfig (cmake/credentials_idf.cmake).

    config HAC_MQTT_USER
        string "MQTT user"
        default ""
        help
            The user the board logs in as, or empty for an anonymous broker.
            In sdkconfig.credentials, never anywhere committed.

    config HAC_MQTT_PASSWORD
        string "MQTT password"
        default ""
        help
            The user's password, or empty. Sent only with a user name (MQTT
            3.1.1, 3.1.2.9), in clear text over the LAN: no TLS (ADR 0033).
            In sdkconfig.credentials, never anywhere committed; never logged
            -- the boot log gives its length. An image built with it holds it
            in plain text: never attach one to an issue or a pull request.

    config HAC_MQTT_TOPIC_PREFIX
        string "MQTT topic prefix"
        default "homeair"
        help
            The first levels of the device's topics, <prefix>/<device
            id>/state and .../status (core/reporting/topics.h): one or more
            levels of [A-Za-z0-9_-], separated by single '/', at most 48
            characters -- an invalid one leaves MQTT off, and the boot log
            says why. The device id is the station MAC's, hac- and twelve
            hex digits. "homeair", the default, is requirements 10.1's
            example and the simulator's; a household with its own prefix sets
            it in sdkconfig.credentials with the broker.

endmenu
```

## apps/firmware_esp32/main/Kconfig.projbuild
```kconfig
# SPDX-License-Identifier: Apache-2.0

menu "Home Air Monitor"

    config HAC_DISPLAY_NULL
        bool "Use the null display adapter (no panel driven)"
        default n
        help
            Keeps apps/firmware_esp32 running the phase 2a null display
            adapter (platform/esp32_t5s3/adp_display_null.c), which reports
            real panel geometry and refresh limits and allocates the real
            PSRAM framebuffer but never touches the panel -- for headless
            firmware runs (CI, a board with no panel attached, or bring-up
            work on the FreeRTOS pump and update_policy in isolation from
            the display backend).

            Leave this unset for a normal build: the firmware drives the
            physical ED047TC1 panel through EPDiy
            (platform/esp32_t5s3/adp_display.c), as phase 2b intends.

    config HAC_EPD_TEST_PATTERN
        bool "Drive a whole-panel test pattern once at startup"
        default n
        depends on !HAC_DISPLAY_NULL && !HAC_EPD_CALIBRATION
        help
            Phase 2b/2c bring-up diagnostic (apps/firmware_esp32/main/main.c,
            run_epd_test_pattern): before the event loop starts, fill the
            framebuffer solid black and flush it as a full refresh, which this
            backend renders as epd_clear() -- a visible whole-panel cycle to
            white -- followed by a MODE_GC16 redraw. A panel that stays blank
            through that is a driver or wiring problem; one that visibly cycles
            and settles on black has been driven correctly, so a wrong image
            afterwards is a rendering problem instead.

            COSTS ONE MINUTE OF BOOT TIME. The diagnostic is a whole-panel
            refresh, and the panel reports a minimum interval between those
            (BOARD_EPD_MIN_FULL_REFRESH_INTERVAL_MS, 60 s -- a guard, not a
            measurement; see board_config.h). Honouring it means waiting that interval
            out before the first rendered frame, rather than handing over to
            core/app/update_policy.c -- which has no way to know about a
            refresh it never issued -- and letting it add a second whole-panel
            refresh immediately.

            Off by default since phase 2c, whose calibration run drove this
            panel through every refresh mode: the question it answers is
            settled for this unit. Turn it on to bring up a second one. With
            it off, a boot performs exactly one whole-panel refresh,
            screen_home's own first frame, and reaches it immediately.

    config HAC_EPD_CALIBRATION
        bool "Panel calibration mode: time every refresh mode, probe ghosting"
        default n
        depends on !HAC_DISPLAY_NULL
        help
            Phase 2c (apps/firmware_esp32/main/epd_calibration.c). Replaces
            the normal firmware: no event loop runs. Instead the board

              1. runs a ghosting probe -- one full refresh of screen_home,
                 then HAC_EPD_CALIBRATION_GHOST_PARTIALS partial refreshes of
                 it with the CO2 headline stepping like the bring-up
                 sawtooth, each numbered on the panel, then a full refresh.
                 Someone has to watch the panel for this part;
              2. times every refresh_mode_t through port_display->flush()
                 with esp_timer -- REFRESH_CLEAR, REFRESH_FULL (solid black
                 and screen_home), REFRESH_PARTIAL and REFRESH_FAST_MONO over
                 rectangles of several widths and heights -- and logs min,
                 max and mean per case;
              3. leaves a 16-level grey ramp on the panel.

            Whole-panel drives are spaced by the panel's reported minimum
            full-refresh interval and the timing batches stay inside its
            partial-refresh budget, so a full run takes roughly 20 minutes
            at the defaults. The ghosting probe deliberately exceeds the
            budget -- finding the real one is its purpose -- and is bounded
            by its own count below.

            Kept rather than deleted after phase 2c because e-paper timing
            depends on temperature and on the individual panel: a second
            unit, or this one in a cold room, is re-measured by building
            with sdkconfig.calibration (see that file). Leave this n for
            every normal build.

    if HAC_EPD_CALIBRATION

        config HAC_EPD_CALIBRATION_ITERATIONS
            int "Iterations per timing case (0 skips the timing)"
            range 0 20
            default 5
            help
                Each iteration yields one sample per whole-panel case and two
                per partial or fast-mono case (there and back). Each
                iteration costs three of the panel's minimum full-refresh
                intervals. 0 runs the ghosting probe and the grey ramps only
                (sdkconfig.calibration_ghost_shift does).

        choice HAC_EPD_CALIBRATION_GHOST_PATTERN
            prompt "Ghosting probe pattern"
            default HAC_EPD_CALIBRATION_GHOST_SAWTOOTH
            help
                What the CO2 headline does between probe steps. See
                epd_calibration.c for why there are two.

            config HAC_EPD_CALIBRATION_GHOST_SAWTOOTH
                bool "Sawtooth: CO2 walks as the bring-up data does"

            config HAC_EPD_CALIBRATION_GHOST_SHIFT
                bool "Shift: CO2 alternates between 3 and 4 digits every step"

        endchoice

        config HAC_EPD_CALIBRATION_GHOST_PARTIALS
            int "Partial refreshes in the ghosting probe (0 skips it)"
            range 0 100
            default 40
            help
                An upper bound, not a target: the probe always ends with a
                full refresh, which is what clears the residue. Twice the
                partial-refresh budget the panel reported before phase 2c
                measured it. Resetting the board at any point also ends the
                probe -- the next boot's first frame is a full refresh.

        config HAC_EPD_CALIBRATION_GHOST_PAUSE_MS
            int "Pause between ghosting-probe partial refreshes (ms)"
            range 0 60000
            default 6000
            help
                Time for the observer to look at the panel after each step.
                Real use spaces partial refreshes by tens of seconds; if
                residue relaxes between drives, a shorter pause here
                overstates ghosting, which errs towards a smaller budget --
                the safe direction. The probe does not separate the two.

        config HAC_EPD_CALIBRATION_RESIDUE_NORMAL_FULLS
            int "Residue test: ordinary full refreshes, each shown on a ramp"
            range 0 10
            default 0
            help
                Whether residue left by partial refreshes fades under the
                full refreshes the product already does. 0 skips this half.
                See run_residue_test() in epd_calibration.c.

        config HAC_EPD_CALIBRATION_RESIDUE_DEEP_EVENTS
            int "Residue test: deep-clean events, each shown on a ramp"
            range 0 10
            default 0
            help
                Each event runs HAC_EPD_CALIBRATION_RESIDUE_EXTRA_CLEARS
                REFRESH_CLEARs back to back and then the ramp's own full
                refresh: what a REFRESH_FULL with more clear cycles would do.
                0 skips this half.

        config HAC_EPD_CALIBRATION_RESIDUE_EXTRA_CLEARS
            int "Residue test: extra REFRESH_CLEARs per deep event"
            range 0 10
            default 2

    endif

endmenu
```
